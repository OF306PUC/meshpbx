## prj.conf
```kconfig
# =============================================================================
# Meshtastic BLE Proxy — nRF52840
# =============================================================================

# -----------------------------------------------------------------------------
# Bluetooth — Peripheral, up to 6 simultaneous connections
# -----------------------------------------------------------------------------
CONFIG_BT=y
CONFIG_BT_PERIPHERAL=y
CONFIG_BT_MAX_CONN=6
# ACL TX buffer pool: at least one per connection to avoid head-of-line blocking
CONFIG_BT_BUF_ACL_TX_COUNT=8

# -----------------------------------------------------------------------------
# Connection parameters — wide range so Android's param update is accepted
# Android sends LL_CONNECTION_PARAM_REQ at ~1-3s; if outside preferred range
# Zephyr rejects it and Android disconnects with 0x13.
# Units: 1.25 ms per interval unit, 10 ms per timeout unit.
# -----------------------------------------------------------------------------
CONFIG_BT_PERIPHERAL_PREF_MIN_INT=6
CONFIG_BT_PERIPHERAL_PREF_MAX_INT=100
CONFIG_BT_PERIPHERAL_PREF_LATENCY=0
CONFIG_BT_PERIPHERAL_PREF_TIMEOUT=400
# Must match BLE_NAME_PATTERN: ^.*_([0-9a-fA-F]{4})$
# Last 4 chars = hex suffix (ideally derived from MAC). Change before flashing.
CONFIG_BT_DEVICE_NAME="Meshtastic_CA1E"
#CONFIG_BT_DEVICE_NAME="Meshtastic_0711"     # MIDE Building - Proxy 1
#CONFIG_BT_DEVICE_NAME="Meshtastic_0306"     # Electrical Engineering Building - Proxy 2

# -----------------------------------------------------------------------------
# nanopb — protobuf decode for FromRadio routing (Phase 3)
# -----------------------------------------------------------------------------
CONFIG_NANOPB=y
CONFIG_RING_BUFFER=y

# ATT: larger MTU so FromRadio packets fit in a single read (no long-read needed)
CONFIG_BT_L2CAP_TX_MTU=251
CONFIG_BT_BUF_ACL_RX_SIZE=256
CONFIG_BT_BUF_ACL_TX_SIZE=256

# Static GATT table (BT_GATT_SERVICE_DEFINE)
CONFIG_BT_GATT_DYNAMIC_DB=n

# SMP: allow Android "Just Works" bonding.
# Android always sends Pairing Request with auth_req bonding flag set.
# CONFIG_BT_BONDABLE=n causes Zephyr to respond with bonding=0, which
# Android rejects after 3s (0x13). Allowing bonding with MAX_PAIRED=6
# lets Android complete the SC pairing and stay connected.
# Bonds are RAM-only (no CONFIG_BT_SETTINGS) — lost on reboot, which is
# fine: Android re-pairs on next connect with "Just Works".
CONFIG_BT_SMP=y
CONFIG_BT_MAX_PAIRED=6
CONFIG_BT_SMP_SC_ONLY=n
CONFIG_BT_SMP_SC_PAIR_ONLY=n

# -----------------------------------------------------------------------------
# GPIO — blinky activity LEDs (BLE read/write events)
# -----------------------------------------------------------------------------
CONFIG_GPIO=y

# -----------------------------------------------------------------------------
# UART — Meshtastic serial link on UART1 (P1.01 RX / P1.02 TX)
# -----------------------------------------------------------------------------
CONFIG_SERIAL=y
CONFIG_UART_ASYNC_API=y
# Hardware-async RX: a dedicated TIMER (via PPI) counts received bytes so the
# async driver can flush a PARTIAL DMA buffer on the UART_RX_TIMEOUT_US idle
# gap — not only when the 256-byte buffer fills. Without this, a lone FromRadio
# frame stalled in the DMA buffer until unrelated later traffic topped it up,
# coupling inbound delivery to outbound sends. TIMER0 is owned by the BLE
# controller; TIMER2 is free.
CONFIG_UART_1_NRF_HW_ASYNC=y
CONFIG_UART_1_NRF_HW_ASYNC_TIMER=2

# -----------------------------------------------------------------------------
# Logging (UART0 / JLink — independent of Meshtastic UART1)
# -----------------------------------------------------------------------------
CONFIG_LOG=y
CONFIG_LOG_DEFAULT_LEVEL=3
# Larger log buffer: the bonding/config phase bursts a lot of log traffic; a
# small buffer makes the log core drop its own lines ("--- N messages dropped ---").
CONFIG_LOG_BUFFER_SIZE=8192

# BT stack debug was only needed while chasing the 0x13 disconnect, which is now
# resolved (stable multi-phone connections). Removed: the DBG flood overran the
# log backend during bonding and caused dropped log lines. Re-enable temporarily
# if a new connection-layer issue needs tracing.
#   CONFIG_BT_CONN_LOG_LEVEL_DBG=y
#   CONFIG_BT_SMP_LOG_LEVEL_DBG=y

# -----------------------------------------------------------------------------
# Route tracing (debug) — per-hop "ROUTE UP/DN ..." logs of the message path.
# Master switch: compiles the trace calls out entirely when =n (zero overhead).
# _PAYLOAD additionally hexdumps ToRadio/FromRadio payloads (ASCII column shows
# text-message content). Turn both off for production builds.
# -----------------------------------------------------------------------------
CONFIG_MESHTASTIC_ROUTE_TRACE=y
CONFIG_MESHTASTIC_ROUTE_TRACE_PAYLOAD=y

# -----------------------------------------------------------------------------
# Memory
# -----------------------------------------------------------------------------
CONFIG_HEAP_MEM_POOL_SIZE=8192
CONFIG_MAIN_STACK_SIZE=4096
CONFIG_SYSTEM_WORKQUEUE_STACK_SIZE=2048
```

## src/main.c
```c
#include <zephyr/kernel.h>
#include <zephyr/bluetooth/bluetooth.h>
#include <zephyr/logging/log.h>
#include <zephyr/sys/byteorder.h>
#include <inttypes.h>
#include "ble_gatt.h"
#include "uart_meshtastic.h"
#include "proto_handler.h"
#include "router.h"
#include "upstream_session.h"
#include "proxy_protocol.h"
#include "route_trace.h"

LOG_MODULE_REGISTER(main, LOG_LEVEL_INF);

/*
 * Called (system work-queue context) when the UART driver has assembled a
 * complete FromRadio frame from the Meshtastic node.
 *
 * Flow:
 *   1. Decode the protobuf (nanopb) to extract routing fields.
 *   2. Dispatch raw bytes to the correct BLE connection(s) via the router.
 *
 * On decode failure the raw bytes are still broadcast so no packet is dropped.
 */
static void on_fromradio_uart(const uint8_t *payload, uint16_t len)
{
    struct fromradio_info info;

    if (proto_decode_fromradio(payload, len, &info) != 0) {
        /* Decode failed (malformed frame?). Broadcast raw as fallback. */
        LOG_WRN("FromRadio decode failed — broadcasting raw (%d B)", len);
        ble_gatt_broadcast_fromradio(payload, len);
        return;
    }

    router_dispatch(payload, len, &info);
}

/*
 * Called when a phone writes a ToRadio protobuf to the GATT TORADIO
 * characteristic (per-phone config-session virtualization).
 *
 * The proxy is NO LONGER a blind passthrough:
 *   - want_config_id : served LOCALLY from the cache (replay or PENDING).
 *                      NEVER forwarded to UART — forwarding it would restart the
 *                      node's single global config session and clobber every
 *                      other phone's in-flight handshake.
 *   - heartbeat      : absorbed locally — answered with a synthesized
 *                      queueStatus for liveness; NEVER forwarded to UART. The
 *                      node's serial link is kept alive by the proxy's own
 *                      keepalive, and delivery of inbound FromRadio is driven by
 *                      the node's push (not by client ToRadio), so forwarding
 *                      heartbeats is unnecessary.
 *   - anything else  : a real packet → forwarded to the node via UART as today.
 *
 * On decode failure we forward the raw bytes best-effort (no silent drop).
 */
static void on_toradio_ble(struct bt_conn *conn, const uint8_t *data, uint16_t len)
{
    struct toradio_info ti;

    if (proto_decode_toradio(data, len, &ti) != 0) {
        /* Malformed ToRadio — forward best-effort so nothing is silently lost. */
        LOG_WRN("ToRadio decode failed (%d B) from conn %p — forwarding raw",
                len, (void *)conn);
        (void)uart_meshtastic_tx(data, len);
        return;
    }

    if (ti.has_want_config) {
        /* Serve config locally: replay if the cache is ready, else PENDING. */
        enum upstream_state st = upstream_get_state();

        if(st != UPSTREAM_LIVE && st != UPSTREAM_CACHE_READY) {
            return;
        }

        if (st == UPSTREAM_CACHE_READY || st == UPSTREAM_LIVE || st == UPSTREAM_REFETCHING) {
            LOG_INF("want_config nonce=%u from conn %p → replay cached burst",
                    (unsigned)ti.want_config_id, (void *)conn);
            ble_gatt_replay_cached_burst(conn, ti.want_config_id);
        } else {
            LOG_INF("want_config nonce=%u from conn %p → PENDING (cache not ready)",
                    (unsigned)ti.want_config_id, (void *)conn);
            ble_gatt_park_pending(conn, ti.want_config_id);
        }
        return;  /* NEVER forward want_config to UART. */
    }

    if (ti.has_heartbeat) {
        /* Absorbed locally: reply a synthesized queueStatus to keep the
         * phone's liveness timer alive. */
        ble_gatt_reply_queuestatus(conn);
        return;
    }

    if (ti.has_disconnect) {
        /* Two independent actions, both required:
         *
         * 1. Absorb toward the node: never forward through UART. The node's
         *    PhoneAPI session is shared by every phone, and disconnect would put
         *    it in STATE_SEND_NOTHING, stalling toPhoneQueue for everyone.
         *
         * 2. Release toward the phone: tear down this phone's slot. Without
         *    this, a phone that ends its API session but leaves the BLE link up
         *    leaks its slot and its FromRadio queue overflows on every frame
         *    forever. See ble_gatt_request_teardown(). */
        LOG_INF("ToRadio disconnect from conn %p — absorbed (not forwarded)", (void *)conn);
        ble_gatt_request_teardown(conn);
        return;
    }

#if IS_ENABLED(CONFIG_MESHTASTIC_ROUTE_TRACE)
    /* TESTING ONLY: Assumes proxy-framed payload with 4-byte IDs. */
    if (ti.is_packet && ti.portnum == PROXY_PORTNUM && ti.payload_len >= PROXY_HEADER_SIZE) {
        ROUTE_TRACE("ROUTE UP  hdr=[%02x][0x%08" PRIx32 "][0x%08" PRIx32 "] content='%.*s'",
                    ti.payload_bytes[PROXY_OFF_VERSION],
                    sys_get_be32(&ti.payload_bytes[PROXY_OFF_SRC]),
                    sys_get_be32(&ti.payload_bytes[PROXY_OFF_DST]),
                    (int)(ti.payload_len - PROXY_HEADER_SIZE),
                    (const char *)&ti.payload_bytes[PROXY_OFF_CONTENT]);
        ROUTE_TRACE_HEXDUMP(ti.payload_bytes, ti.payload_len, "ROUTE UP payload");
    }
#endif
    /* Real packet → forward to the node, and push the upstream keepalive out
     * the keepalive only fires after a stretch of true silence. */
    int err = uart_meshtastic_tx(data, len);
    if (err == -ENOMEM) {
        LOG_WRN("TX queue full — ToRadio from conn %p dropped", (void *)conn);
    } else if (err) {
        LOG_ERR("uart_meshtastic_tx: %d", err);
    } else {
        upstream_keepalive_reschedule();
    }
}

int main(void)
{
    int err;

    LOG_INF("=== Meshtastic BLE Proxy starting ===");

    /* 1. Init GATT service (must happen before bt_enable). */
    err = ble_gatt_init(on_toradio_ble);
    if (err) {
        LOG_ERR("ble_gatt_init: %d", err);
        return err;
    }

    /* 2. Enable Bluetooth stack. */
    err = bt_enable(NULL);
    if (err) {
        LOG_ERR("bt_enable: %d", err);
        return err;
    }
    LOG_INF("Bluetooth ready");

    /* 3. Start advertising as a Meshtastic-compatible peripheral. */
    err = ble_gatt_start_advertising();
    if (err) {
        return err;
    }

    /* 4. Init UART driver — starts DMA reception immediately.
     *    The Meshtastic node begins sending FromRadio frames once it receives
     *    the proxy's own want_config_id ToRadio (sent by upstream_session_start
     *    below), not a phone's — phones are served from the cache. */
    err = uart_meshtastic_init(on_fromradio_uart);
    if (err) {
        LOG_ERR("uart_meshtastic_init: %d", err);
        return err;
    }

    /* 5. Wire the per-phone replay callback BEFORE starting the upstream fetch,
     *    so any PENDING phone queued during FETCHING is served the instant the
     *    cache becomes ready. */
    upstream_set_serve_cb(ble_gatt_replay_cached_burst);

    /* 6. Kick off the proxy's own boot want_config: fetch the node's config
     *    burst into the cache, then go LIVE. Phones connecting before the cache
     *    is ready are parked PENDING and replayed once ready. */
    upstream_session_start();

    /* Main loop — all work runs in the system work queue and BT callbacks. */
    while (1) {
        k_sleep(K_MSEC(100));
    }

    return 0;
}
```

## src/ble_gatt.h
```c
#ifndef BLE_GATT_H
#define BLE_GATT_H

#include <stdint.h>
#include <zephyr/bluetooth/conn.h>
#include "proxy_protocol.h"

/* Max simultaneous BLE connections (phones).
 * Tied to CONFIG_BT_MAX_CONN so the app-layer slot array always matches the
 * BT stack limit. Change prj.conf (CONFIG_BT_MAX_CONN) to resize both at once. */
#define MAX_BLE_CONNECTIONS     CONFIG_BT_MAX_CONN

/* Per-connection FromRadio packet queue depth */
#define FROMRADIO_QUEUE_DEPTH   16

/* Max size of a single FromRadio protobuf packet (bytes) */
#define FROMRADIO_MAX_PKT_SIZE  512

/*
 * Per-phone config-session state.
 *
 *   CONNECTED          → just connected (CCCD not yet subscribed)
 *   AWAIT_WANT_CONFIG  → subscribed, waiting for the phone's want_config
 *   PENDING            → asked for config before the cache was ready; queued in
 *                        upstream_session and served once CACHE_READY
 *   REPLAYING          → mid burst replay (cursor walking the shared cache)
 *   ACTIVE             → burst replayed + config_complete sent; live traffic
 */
enum phone_state {
    PHONE_CONNECTED,
    PHONE_AWAIT_WANT_CONFIG,
    PHONE_PENDING,
    PHONE_REPLAYING,
    PHONE_ACTIVE,
};

/**
 * Callback fired when a connected phone writes to the TORADIO characteristic.
 *
 * @param conn  BLE connection that sent the data.
 * @param data  Raw protobuf bytes (ToRadio message, already encoded by the app).
 * @param len   Length in bytes.
 */
typedef void (*toradio_cb_t)(struct bt_conn *conn, const uint8_t *data, uint16_t len);

/** Initialize GATT service and connection tracking. Must be called before bt_enable(). */
int ble_gatt_init(toradio_cb_t cb);

/** Start BLE advertising (Meshtastic-compatible). Called at boot and after each connection. */
int ble_gatt_start_advertising(void);

/**
 * Enqueue a FromRadio packet for a specific BLE connection.
 * Triggers a FROMNUM notification to the phone.
 *
 * @return  0        success
 *         -ENOENT   connection not tracked
 *         -ENOMEM   per-connection queue full
 *         -EMSGSIZE packet exceeds FROMRADIO_MAX_PKT_SIZE
 */
int ble_gatt_enqueue_fromradio(struct bt_conn *conn, const uint8_t *data, uint16_t len);

/**
 * Enqueue a FromRadio packet for ALL currently connected BLE clients.
 * Used for config/meta variants and broadcast mesh packets.
 *
 * @return Number of connections that received the packet (0 if none connected).
 */
int ble_gatt_broadcast_fromradio(const uint8_t *data, uint16_t len);

/**
 * Return the BLE connection whose registered proxy_id matches the given id.
 * Returns NULL if no connection has registered that id.
 *
 * Used by the router to target a specific phone by its proxy identifier.
 */
struct bt_conn *ble_gatt_get_conn_by_proxy_id(const proxy_id_t *id);

/**
 * Register a proxy identifier (phone number, UUID, etc.) for a BLE connection.
 *
 * Called from the NODE_REG GATT write handler when a phone writes its 16-byte
 * identifier.  The router uses this mapping to perform targeted delivery.
 *
 * @param conn  The BLE connection registering.
 * @param id    16-byte proxy identifier written by the phone.
 * @return 0 on success, -ENOENT if connection is not tracked.
 */
int ble_gatt_register_proxy_id(struct bt_conn *conn, const proxy_id_t *id);

/*
 * Replay the boot-populated config cache to a single phone, then close the
 * burst with a synthesized FromRadio{config_complete_id = nonce} carrying THAT
 * phone's nonce (per-phone replay).
 *
 * Frames are read straight from the shared config_cache arena via a cursor and
 * enqueued one by one — the whole burst is never copied into the per-conn queue
 * as a block (avoids N× RAM duplication). On completion the phone goes ACTIVE.
 *
 * Called from on_toradio_ble (cache already ready) and registered with
 * upstream_session as the serve callback for PENDING phones.
 */
void ble_gatt_replay_cached_burst(struct bt_conn *conn, uint32_t nonce);

/*
 * Park a phone as PENDING: it asked for config before the cache was ready.
 * Records the phone's nonce and registers it with upstream_session, which
 * replays the burst (via the serve callback) once CACHE_READY.
 */
void ble_gatt_park_pending(struct bt_conn *conn, uint32_t nonce);

/*
 * Reactive BLE liveness reply. Enqueue a synthesized FromRadio{
 * queueStatus} to this connection (bumps fromnum + notifies FROMNUM) in
 * response to the phone's ToRadio.heartbeat. The phone reads it as "radio
 * data", keeping its app-layer liveness timer from tripping. Absorbed locally
 * — the heartbeat is NEVER forwarded to UART. The queueStatus is encoded once
 * and reused.
 */
void ble_gatt_reply_queuestatus(struct bt_conn *conn);

/*
 * Release this phone's slot after it sent ToRadio{disconnect}.
 *
 * Marks the slot as leaving (further FromRadio frames are refused with
 * -ESHUTDOWN) and schedules the BLE link teardown ~250 ms later, which triggers
 * the normal on_disconnected() → free_slot() cleanup.
 *
 * Why the proxy forces this rather than waiting for the phone: the app intends
 * to drop the link itself, but cannot guarantee it. FlutterBluePlus queues its
 * disconnect behind other operations for the device, skips the wait when the
 * platform reports no state change, and is subject to the documented Android
 * "stranded connection" race (no gatt handle → the link can never be closed
 * from the app side). Link supervision does not rescue this either: the
 * observed leak survived 3+ minutes against a 4 s configured timeout, because
 * the connection stayed alive at the link layer while being dead at the app
 * layer. The ToRadio{disconnect} write is the one signal that reliably arrives,
 * so it is treated as authoritative.
 *
 * Safe when the app's own disconnect wins the race — bt_conn_disconnect() then
 * returns -ENOTCONN and the teardown is a no-op.
 *
 * @return  0        teardown scheduled
 *         -ENOENT   connection not tracked
 */
int ble_gatt_request_teardown(struct bt_conn *conn);


#endif /* BLE_GATT_H */
```

## src/pbx_stats.c
```c
/*
 * pbx_stats.c — cumulative counters and their periodic log dump.
 *
 * See pbx_stats.h for why these are running totals rather than events.
 *
 * The line format is a contract with the host-side parser
 * (meshtastic-testbed-platform: src/pbx/collector/pbx_logd.py), so treat it as
 * one:
 *
 *   EVT stats v=1 <key>=<value> ...
 *
 *   * `EVT` is a stable prefix. The parser matches on it and ignores everything
 *     else on the console, so prose warnings can be reworded freely without
 *     breaking anything — which is the whole point of having this line.
 *   * `v=1` versions the field set. ADD keys freely; a parser that does not know
 *     a key ignores it. RENAMING or REMOVING one is a breaking change and must
 *     bump v, or the host silently reads zeros for a counter it thinks it has.
 *   * Values are unsigned and monotonic within a boot.
 */

#include "pbx_stats.h"

#include <zephyr/kernel.h>
#include <zephyr/logging/log.h>

LOG_MODULE_REGISTER(pbx_stats, LOG_LEVEL_INF);

/* atomic_t so the hot paths can increment without taking a lock: these are
 * touched from the BLE stack, the UART callback and the system work queue. */
static atomic_t s_counters[PBX_STAT_COUNT];

static struct k_work_delayable s_dump_work;

/* Keys are short because the whole set shares one log line, and Zephyr truncates
 * a message that exceeds CONFIG_LOG_BUFFER_SIZE — a truncated dump would lose
 * whichever counters sort last. Keep them terse and keep this table in the same
 * order as enum pbx_stat. */
static const char *const s_keys[PBX_STAT_COUNT] = {
	[PBX_STAT_TX_FWD]          = "tx_fwd",
	[PBX_STAT_TX_DROP_TXQ]     = "tx_drop_txq",
	[PBX_STAT_TX_DROP_ERR]     = "tx_drop_err",
	[PBX_STAT_TX_DECODE_FAIL]  = "tx_dec_fail",

	[PBX_STAT_RX_FRAMES]       = "rx_frames",
	[PBX_STAT_RX_OVERRUN_B]    = "rx_ovr_b",
	[PBX_STAT_RX_RESYNC]       = "rx_resync",
	[PBX_STAT_RX_DECODE_FAIL]  = "rx_dec_fail",

	[PBX_STAT_ROUTED]          = "routed",
	[PBX_STAT_BROADCAST]       = "bcast",
	[PBX_STAT_BCAST_FALLBACK]  = "bcast_fb",
	[PBX_STAT_PHONE_Q_DROP]    = "phone_q_drop",

	[PBX_STAT_BLE_CONNECT]     = "ble_conn",
	[PBX_STAT_BLE_DISCONNECT]  = "ble_disc",
	[PBX_STAT_BLE_REJECT]      = "ble_reject",
	[PBX_STAT_NODE_REG]        = "node_reg",

	[PBX_STAT_NODE_REBOOT]     = "node_reboot",
	[PBX_STAT_SESSION_REFETCH] = "sess_refetch",
	[PBX_STAT_KEEPALIVE_FAIL]  = "ka_fail",
};

BUILD_ASSERT(ARRAY_SIZE(s_keys) == PBX_STAT_COUNT,
	     "every pbx_stat needs a key, or the dump silently omits it");

void pbx_stats_inc(enum pbx_stat stat)
{
	if ((unsigned)stat < PBX_STAT_COUNT) {
		atomic_inc(&s_counters[stat]);
	}
}

void pbx_stats_add(enum pbx_stat stat, uint32_t delta)
{
	if ((unsigned)stat < PBX_STAT_COUNT) {
		atomic_add(&s_counters[stat], (atomic_val_t)delta);
	}
}

void pbx_stats_dump(void)
{
	/* Built into one buffer rather than logged per counter: the host must see
	 * a consistent snapshot, and nineteen separate lines could interleave with
	 * other modules' output or be partially dropped.
	 *
	 * Sized for the worst case, which is every counter at its widest decimal
	 * form: the key names total 181 bytes, and each of the 19 entries adds a
	 * space, an '=' and up to 10 digits, so 181 + 19*12 = 409 plus the prefix.
	 * 512 leaves room for keys added later. The runtime guard below is what
	 * actually protects correctness — this figure only keeps it from firing.
	 *
	 * The line is passed to LOG_INF as a %s argument, which Zephyr copies into
	 * the log buffer in deferred mode. CONFIG_LOG_BUFFER_SIZE has to be
	 * comfortably larger than this or dumps are what gets dropped first. */
	char line[512];
	size_t used = 0;
	int n;

	for (int i = 0; i < PBX_STAT_COUNT; i++) {
		n = snprintk(line + used, sizeof(line) - used, " %s=%u",
			     s_keys[i], (unsigned)atomic_get(&s_counters[i]));
		if (n < 0 || (size_t)n >= sizeof(line) - used) {
			/* Refuse to emit a half-line: a truncated dump reads as
			 * "these counters are zero" to the parser, which is worse
			 * than no dump at all. */
			LOG_ERR("EVT stats truncated at %d/%d keys — raise the buffer",
				i, PBX_STAT_COUNT);
			return;
		}
		used += (size_t)n;
	}

	LOG_INF("EVT stats v=1%s", line);
}

static void dump_work_handler(struct k_work *work)
{
	pbx_stats_dump();
	k_work_reschedule(k_work_delayable_from_work(work),
			  K_SECONDS(CONFIG_MESHTASTIC_STATS_PERIOD_S));
}

void pbx_stats_start(void)
{
	k_work_init_delayable(&s_dump_work, dump_work_handler);
	/* Dump immediately so a run has a baseline from its first second, rather
	 * than a first data point one period in with unknown history behind it. */
	k_work_schedule(&s_dump_work, K_NO_WAIT);
	LOG_INF("stats dump every %d s", CONFIG_MESHTASTIC_STATS_PERIOD_S);
}
```

## src/pbx_stats.h
```c
#ifndef PBX_STATS_H
#define PBX_STATS_H

#include <stdint.h>

/*
 * Cumulative counters, dumped periodically as one log line.
 *
 * WHY CUMULATIVE AND NOT EVENTS
 *
 * The individual drop sites already log a warning each time they fire, which is
 * right for a human reading the console but useless for measurement: the
 * collector on the host parses this log, and Zephyr drops log messages when its
 * buffer fills. A missed "dropped" warning is a loss that is undercounted
 * FOREVER, silently, and the resulting delivery ratio is simply wrong with
 * nothing anywhere to indicate it.
 *
 * A running total is self-healing instead. Every dump carries the complete
 * state, so a dropped line costs nothing — the next line still reports the
 * correct figure. Stock Meshtastic already does this on its own console
 * (`txGood=…,txRelay=…,rxGood=…,rxBad=…`), which is what made the host-side
 * parser for that device reliable; this brings the proxy up to the same standard.
 *
 * One line holds every counter on purpose. Splitting them across lines would
 * reintroduce the problem for whichever line went missing.
 *
 * Counters are monotonic and never reset except by reboot, which the host
 * detects from the uptime in the log timestamp going backwards.
 */

enum pbx_stat {
	/* ── Uplink: phone → proxy → node ─────────────────────────────────── */
	PBX_STAT_TX_FWD,          /* ToRadio frames handed to the UART           */
	PBX_STAT_TX_DROP_TXQ,     /* dropped: UART TX queue full                 */
	PBX_STAT_TX_DROP_ERR,     /* dropped: uart_meshtastic_tx returned error   */
	PBX_STAT_TX_DECODE_FAIL,  /* ToRadio would not decode; forwarded raw     */

	/* ── Downlink: node → proxy → phone ───────────────────────────────── */
	PBX_STAT_RX_FRAMES,       /* complete FromRadio frames off the UART      */
	PBX_STAT_RX_OVERRUN_B,    /* bytes lost to a full RX ring                */
	PBX_STAT_RX_RESYNC,       /* mid-frame stalls and bad lengths, resynced  */
	PBX_STAT_RX_DECODE_FAIL,  /* FromRadio would not decode; broadcast raw   */

	/* ── Routing ──────────────────────────────────────────────────────── */
	PBX_STAT_ROUTED,          /* delivered to one phone by DST_ID            */
	PBX_STAT_BROADCAST,       /* delivered to every connection               */
	PBX_STAT_BCAST_FALLBACK,  /* wanted to route, could not: bad hdr or
	                             DST_ID not registered                       */
	PBX_STAT_PHONE_Q_DROP,    /* dropped: a phone's FromRadio queue was full */

	/* ── BLE session ──────────────────────────────────────────────────── */
	PBX_STAT_BLE_CONNECT,
	PBX_STAT_BLE_DISCONNECT,
	PBX_STAT_BLE_REJECT,      /* refused: no free connection slot            */
	PBX_STAT_NODE_REG,        /* phones that registered a proxy_id           */

	/* ── Upstream session health ──────────────────────────────────────── */
	PBX_STAT_NODE_REBOOT,     /* node restarts the proxy noticed             */
	PBX_STAT_SESSION_REFETCH, /* want_config re-issued after presumed death  */
	PBX_STAT_KEEPALIVE_FAIL,

	PBX_STAT_COUNT
};

/** Increments one counter. Safe from any context; never blocks. */
void pbx_stats_inc(enum pbx_stat stat);

/** Adds to one counter, for byte counts rather than occurrences. */
void pbx_stats_add(enum pbx_stat stat, uint32_t delta);

/**
 * Starts the periodic dump. Call once from main() after logging is up.
 *
 * The period is CONFIG_MESHTASTIC_STATS_PERIOD_S. It should be short relative to
 * how long a measurement run lasts and long relative to the log buffer's drain
 * rate; 30 s matches the gateway receiver's PDR sweep interval.
 */
void pbx_stats_start(void);

/** Emits the dump immediately, in addition to the periodic one. */
void pbx_stats_dump(void);

#endif /* PBX_STATS_H */
```

## src/proto_handler.c
```c
/*
 * proto_handler.c — nanopb decode of Meshtastic FromRadio messages
 *
 * Extracts the fields needed for routing:
 *   - which_payload_variant
 *   - packet.from / packet.to
 *   - packet.decoded.portnum
 *   - packet.decoded.payload.bytes / .size
 *
 * The node decrypts packets before sending over serial, so
 * MeshPacket.which_payload_variant == decoded_tag for all
 * application-layer traffic (see Meshtastic StreamAPI docs).
 *
 * FromRadio raw bytes are NOT re-encoded — forwarded as-is to BLE by the
 * router. The only message the proxy synthesizes (encodes) is the closing
 * FromRadio{config_complete_id} of the per-phone replay; that is built with
 * nanopb pb_encode (never hand-written wire bytes).
 *
 * Threading: every decode/encode entry point uses a module-level static
 * scratch struct (too large for any stack). This is safe ONLY because all
 * decode/cache processing runs on the single Zephyr system work queue —
 * there is no concurrent caller. Do NOT call these from an ISR or a second
 * thread.
 */

#include "proto_handler.h"

#include <string.h>
#include <errno.h>
#include <pb_decode.h>
#include <pb_encode.h>
#include "meshtastic/mesh.pb.h"
#include <zephyr/logging/log.h>

LOG_MODULE_REGISTER(proto_handler, LOG_LEVEL_DBG);

/*
 * Module-level statics: each too large (~2 KB) for any stack. Kept separate
 * (FromRadio vs ToRadio) so a ToRadio decode never clobbers a FromRadio
 * decode in flight. Safe because the single system work queue serializes all
 * access — see the threading note in the file header.
 */
static meshtastic_FromRadio s_fromradio;
static meshtastic_ToRadio   s_toradio;

int proto_decode_fromradio(const uint8_t *buf, uint16_t len,
                           struct fromradio_info *out)
{
    memset(&s_fromradio, 0, sizeof(s_fromradio));
    memset(out, 0, sizeof(*out));

    pb_istream_t stream = pb_istream_from_buffer(buf, len);
    if (!pb_decode(&stream, meshtastic_FromRadio_fields, &s_fromradio)) {
        LOG_WRN("pb_decode: %s", PB_GET_ERROR(&stream));
        return -EINVAL;
    }

    out->which_variant = s_fromradio.which_payload_variant;

    if (s_fromradio.which_payload_variant != meshtastic_FromRadio_packet_tag) {
        /* Config, NodeInfo, MyInfo, Channel, ConfigComplete, etc. */
        LOG_DBG("variant=%d (config/meta)", out->which_variant);
        return 0;
    }

    /* It's a MeshPacket — extract routing fields. */
    out->packet_from = s_fromradio.packet.from;
    out->packet_to   = s_fromradio.packet.to;

    if (s_fromradio.packet.which_payload_variant !=
        meshtastic_MeshPacket_decoded_tag) {
        /* Encrypted packet — cannot inspect payload. */
        out->is_decoded = false;
        LOG_DBG("packet from=0x%08x to=0x%08x (encrypted)",
                out->packet_from, out->packet_to);
        return 0;
    }

    /* Decoded (plaintext) packet — expose portnum + payload. */
    out->is_decoded    = true;
    out->portnum       = s_fromradio.packet.decoded.portnum;
    out->payload_bytes = s_fromradio.packet.decoded.payload.bytes;
    out->payload_len   = (uint16_t)s_fromradio.packet.decoded.payload.size;

    LOG_DBG("packet from=0x%08x to=0x%08x portnum=%u payload=%u B",
            out->packet_from, out->packet_to,
            out->portnum, out->payload_len);

    return 0;
}

int proto_decode_toradio(const uint8_t *buf, uint16_t len,
                         struct toradio_info *out)
{
    /* See file header: s_toradio is reused per call — single-threaded only. */
    memset(&s_toradio, 0, sizeof(s_toradio));
    memset(out, 0, sizeof(*out));

    pb_istream_t stream = pb_istream_from_buffer(buf, len);
    if (!pb_decode(&stream, meshtastic_ToRadio_fields, &s_toradio)) {
        LOG_WRN("ToRadio pb_decode: %s", PB_GET_ERROR(&stream));
        return -EINVAL;
    }

    switch (s_toradio.which_payload_variant) {
    case meshtastic_ToRadio_want_config_id_tag:
        out->has_want_config = true;
        out->want_config_id  = s_toradio.want_config_id;
        LOG_DBG("ToRadio want_config_id=%u", out->want_config_id);
        break;
    case meshtastic_ToRadio_disconnect_tag:
        out->has_disconnect = true;
        LOG_DBG("ToRadio disconnect");
        break;
    case meshtastic_ToRadio_heartbeat_tag:
        out->has_heartbeat = true;
        LOG_DBG("ToRadio heartbeat");
        break;
    default:
        /* packet / xmodem / mqtt / empty — caller forwards. */
        if (s_toradio.which_payload_variant == meshtastic_ToRadio_packet_tag &&
            s_toradio.packet.which_payload_variant ==
                meshtastic_MeshPacket_decoded_tag) {
            /* Decoded phone->radio packet: expose portnum + payload so the
             * forward path can trace the proxy wire header. Bytes are still
             * forwarded verbatim by the caller. */
            out->is_packet     = true;
            out->portnum       = s_toradio.packet.decoded.portnum;
            out->payload_bytes = s_toradio.packet.decoded.payload.bytes;
            out->payload_len   = (uint16_t)s_toradio.packet.decoded.payload.size;
        }

        if (out->is_packet) {
            LOG_DBG("ToRadio variant=%d, portnum=%d (passthrough)",
                s_toradio.which_payload_variant,
                s_toradio.packet.decoded.portnum);
        } else {
            LOG_DBG("ToRadio variant=%d (passthrough)",
                s_toradio.which_payload_variant);
        }
        break;
    }

    return 0;
}

int proto_encode_config_complete(uint32_t nonce, uint8_t *out_buf,
                                 uint16_t buf_size, uint16_t *out_len)
{
    /* Build the FromRadio entirely via nanopb — no hand-written wire bytes. */
    meshtastic_FromRadio fr = meshtastic_FromRadio_init_zero;
    fr.which_payload_variant = meshtastic_FromRadio_config_complete_id_tag;
    fr.config_complete_id    = nonce;

    pb_ostream_t stream = pb_ostream_from_buffer(out_buf, buf_size);
    if (!pb_encode(&stream, meshtastic_FromRadio_fields, &fr)) {
        /* nanopb reports a buffer-too-small condition here as well; map it to
         * -ENOMEM so callers can distinguish it from a structural failure. */
        if (stream.bytes_written >= buf_size) {
            LOG_WRN("config_complete encode: buffer too small (%u B)",
                    buf_size);
            return -ENOMEM;
        }
        LOG_WRN("config_complete pb_encode: %s", PB_GET_ERROR(&stream));
        return -EINVAL;
    }

    *out_len = (uint16_t)stream.bytes_written;
    LOG_DBG("config_complete encoded nonce=%u -> %u B", nonce, *out_len);

    return 0;
}

int proto_encode_heartbeat(uint32_t nonce, uint8_t *out_buf,
                           uint16_t buf_size, uint16_t *out_len)
{
    /* ToRadio{ heartbeat = { nonce } } via nanopb — no hand-written bytes. */
    meshtastic_ToRadio tr = meshtastic_ToRadio_init_zero;
    tr.which_payload_variant = meshtastic_ToRadio_heartbeat_tag;
    tr.heartbeat.nonce       = nonce;

    pb_ostream_t stream = pb_ostream_from_buffer(out_buf, buf_size);
    if (!pb_encode(&stream, meshtastic_ToRadio_fields, &tr)) {
        if (stream.bytes_written >= buf_size) {
            LOG_WRN("heartbeat encode: buffer too small (%u B)", buf_size);
            return -ENOMEM;
        }
        LOG_WRN("heartbeat pb_encode: %s", PB_GET_ERROR(&stream));
        return -EINVAL;
    }

    *out_len = (uint16_t)stream.bytes_written;
    LOG_DBG("heartbeat encoded nonce=%u -> %u B", nonce, *out_len);

    return 0;
}

int proto_encode_queue_status(uint8_t *out_buf, uint16_t buf_size,
                              uint16_t *out_len)
{
    /* FromRadio{ queueStatus } via nanopb. Benign, well-formed values: success
     * (res=0), some free/maxlen capacity, no specific mesh_packet_id. Only used
     * for BLE heartbeat liveness — the phone just needs valid radio data. */
    meshtastic_FromRadio fr = meshtastic_FromRadio_init_zero;
    fr.which_payload_variant      = meshtastic_FromRadio_queueStatus_tag;
    fr.queueStatus.res            = 0;
    fr.queueStatus.free           = 16;
    fr.queueStatus.maxlen         = 16;
    fr.queueStatus.mesh_packet_id = 0;

    pb_ostream_t stream = pb_ostream_from_buffer(out_buf, buf_size);
    if (!pb_encode(&stream, meshtastic_FromRadio_fields, &fr)) {
        if (stream.bytes_written >= buf_size) {
            LOG_WRN("queueStatus encode: buffer too small (%u B)", buf_size);
            return -ENOMEM;
        }
        LOG_WRN("queueStatus pb_encode: %s", PB_GET_ERROR(&stream));
        return -EINVAL;
    }

    *out_len = (uint16_t)stream.bytes_written;
    LOG_DBG("queueStatus encoded -> %u B", *out_len);

    return 0;
}
```

## src/proto_handler.h
```c
#ifndef PROTO_HANDLER_H
#define PROTO_HANDLER_H

#include <stdint.h>
#include <stdbool.h>

/*
 * Routing information extracted from a decoded FromRadio message.
 *
 * payload_bytes / payload_len are valid only when:
 *   which_variant==meshtastic_FromRadio_packet_tag AND is_decoded==true
 *
 * payload_bytes points into proto_handler's internal static buffer.
 * It remains valid until the next call to proto_decode_fromradio().
 * Since all processing is single-threaded (system work queue), this is safe.
 */
struct fromradio_info {
    int       which_variant;    /* meshtastic_FromRadio_*_tag             */
    uint32_t  packet_from;      /* MeshPacket.from                        */
    uint32_t  packet_to;        /* MeshPacket.to                          */
    bool      is_decoded;       /* MeshPacket variant == decoded (not encrypted) */
    uint32_t  portnum;          /* Data.portnum  — valid when is_decoded   */
    const uint8_t *payload_bytes; /* Data.payload.bytes — valid when is_decoded */
    uint16_t  payload_len;      /* Data.payload.size  — valid when is_decoded */
};

/*
 * Decode raw FromRadio protobuf bytes and populate routing fields.
 *
 * Uses a module-level static for the decoded struct (~2 KB) — must not be
 * called concurrently from multiple threads.
 *
 * @return 0 on success, -EINVAL on nanopb decode failure.
 */
int proto_decode_fromradio(const uint8_t *buf, uint16_t len,
                           struct fromradio_info *out);

/*
 * Information extracted from a decoded ToRadio message (phone -> radio).
 *
 * The proxy only cares about two control variants on the BLE write path:
 *   - want_config_id : the phone is requesting the config burst; the proxy
 *                      serves this locally from the cache (never forwards to
 *                      UART). The nonce is echoed back in config_complete_id.
 *   - disconnect     : the phone has disconnected; absorbed locally.
 *   - heartbeat      : serial-link keepalive; absorbed locally (reactive
 *                      queueStatus reply), never forwarded to UART.
 *
 * Any other variant (notably `packet`) leaves both has_* flags false and is
 * forwarded to UART as today.
 */
struct toradio_info {
    bool      has_want_config;  /* which_payload_variant == want_config_id_tag */
    uint32_t  want_config_id;   /* the phone's config nonce — valid iff above  */
    bool      has_disconnect;   /* which_payload_variant == disconnect_tag (4) */
    bool      has_heartbeat;    /* which_payload_variant == heartbeat_tag  (7) */

    /* Decoded MeshPacket payload (phone -> radio real packet). Valid only when
     * is_packet == true; payload_bytes points into proto_handler's internal
     * static buffer (valid until the next proto_decode_toradio call). Exposed
     * so the forward path can inspect the proxy header for tracing without
     * re-decoding — the bytes are still forwarded to UART verbatim. */
    bool      is_packet;        /* packet variant AND decoded (not encrypted)  */
    uint32_t  portnum;          /* Data.portnum — valid when is_packet          */
    const uint8_t *payload_bytes; /* Data.payload.bytes — valid when is_packet */
    uint16_t  payload_len;      /* Data.payload.size  — valid when is_packet    */
};

/*
 * Decode raw ToRadio protobuf bytes (phone -> radio) and populate out.
 *
 * Uses a module-level static for the decoded struct (~2 KB) — separate from
 * the FromRadio static — must not be called concurrently from multiple
 * threads. Safe here because all decode/cache processing runs on the single
 * system work queue (see proto_handler.c).
 *
 * @return 0 on success, -EINVAL on nanopb decode failure.
 */
int proto_decode_toradio(const uint8_t *buf, uint16_t len,
                         struct toradio_info *out);

/*
 * Encode a synthetic FromRadio{config_complete_id = nonce} into out_buf.
 *
 * Used by the per-phone replay path to close a phone's config burst with
 * that phone's own nonce. The message is built with nanopb pb_encode against
 * meshtastic_FromRadio_fields — never hand-written tag/varint bytes.
 *
 * @param nonce     the phone's want_config nonce to echo back.
 * @param out_buf   destination buffer.
 * @param buf_size  size of out_buf in bytes.
 * @param out_len   on success, receives the number of bytes written.
 * @return 0 on success, -ENOMEM if out_buf is too small, -EINVAL on encode
 *         failure.
 */
int proto_encode_config_complete(uint32_t nonce, uint8_t *out_buf,
                                 uint16_t buf_size, uint16_t *out_len);

/*
 * Encode a ToRadio{heartbeat = {nonce}} into out_buf (Task D — upstream UART
 * keepalive). The proxy sends this to the node to refresh the node's serial
 * activity timer (15-min timeout) during idle. nonce MUST NOT be 1 (the node
 * treats nonce==1 specially: it forces a NodeInfo rebroadcast).
 * Built with nanopb pb_encode.
 *
 * @return 0 on success, -ENOMEM if out_buf is too small, -EINVAL on failure.
 */
int proto_encode_heartbeat(uint32_t nonce, uint8_t *out_buf,
                           uint16_t buf_size, uint16_t *out_len);

/*
 * Encode a synthetic FromRadio{queueStatus} into out_buf (Task D — reactive BLE
 * liveness reply). The node sends a queueStatus in response to a client
 * heartbeat, but it is NOT part of the want_config burst (so it is not cached);
 * the proxy synthesizes a well-formed, benign one (res=0, free/maxlen set,
 * mesh_packet_id=0) so a phone's heartbeat gets the radio-data reply that keeps
 * its liveness timer from tripping. Built with nanopb pb_encode.
 *
 * @return 0 on success, -ENOMEM if out_buf is too small, -EINVAL on failure.
 */
int proto_encode_queue_status(uint8_t *out_buf, uint16_t buf_size,
                              uint16_t *out_len);

#endif /* PROTO_HANDLER_H */
```

## src/proxy_protocol.c
```c
/*
 * proxy_protocol.c — application-layer proxy header parser / builder
 *
 * No Zephyr or Meshtastic dependencies — pure C for portability and testability.
 */

#include "proxy_protocol.h"
#include <string.h>
#include <stdio.h>


uint32_t proxy_id_value(const uint8_t *bytes)
{
    return (uint32_t)bytes[3]
        | ((uint32_t)bytes[2] <<  8)
        | ((uint32_t)bytes[1] << 16)
        | ((uint32_t)bytes[0] << 24); 
}

bool proxy_header_parse(const uint8_t *payload, uint16_t len,
                        struct proxy_header *out)
{
    if (len < PROXY_HEADER_SIZE) {
        return false;
    }
    if (payload[PROXY_OFF_VERSION] != PROXY_VERSION) {
        return false;
    }

    memcpy(out->src.bytes, &payload[PROXY_OFF_SRC], PROXY_ID_SIZE);
    memcpy(out->dst.bytes, &payload[PROXY_OFF_DST], PROXY_ID_SIZE);
    out->content     = &payload[PROXY_OFF_CONTENT];
    out->content_len = len - PROXY_HEADER_SIZE;

    return true;
}

uint16_t proxy_header_build(const proxy_id_t *src,
                            const proxy_id_t *dst,
                            const uint8_t    *content,
                            uint16_t          content_len,
                            uint8_t          *dst_buf,
                            uint16_t          dst_buf_size)
{
    if (content_len > PROXY_CONTENT_MAX) {
        return 0U;
    }

    uint16_t total = (uint16_t)(PROXY_HEADER_SIZE + content_len);
    if (total > dst_buf_size) {
        return 0U;
    }

    dst_buf[PROXY_OFF_VERSION] = PROXY_VERSION;
    memcpy(&dst_buf[PROXY_OFF_SRC], src->bytes, PROXY_ID_SIZE);
    memcpy(&dst_buf[PROXY_OFF_DST], dst->bytes, PROXY_ID_SIZE);

    if (content_len > 0U && content != NULL) {
        memcpy(&dst_buf[PROXY_OFF_CONTENT], content, content_len);
    }

    return total;
}

bool proxy_id_equal(const proxy_id_t *a, const proxy_id_t *b)
{
    return memcmp(a->bytes, b->bytes, PROXY_ID_SIZE) == 0;
}

bool proxy_id_is_zero(const proxy_id_t *id)
{
    for (uint8_t i = 0U; i < PROXY_ID_SIZE; i++) {
        if (id->bytes[i] != 0U) {
            return false;
        }
    }
    return true;
}

void proxy_id_from_str(proxy_id_t *id, const char *str)
{
    memset(id->bytes, 0, PROXY_ID_SIZE);
    if (str == NULL) {
        return;
    }
    size_t len = strlen(str);
    if (len > PROXY_ID_SIZE) {
        len = PROXY_ID_SIZE;
    }
    memcpy(id->bytes, str, len);
}

const char *proxy_id_to_str(const proxy_id_t *id, char *out, size_t out_size)
{
    if (out == NULL || out_size == 0U) {
        return out;
    }
    if (id == NULL) {
        snprintf(out, out_size, "(null)");
        return out;
    }

    snprintf(out, out_size, "%u", (unsigned)proxy_id_value(id->bytes)); 
    return out;
}

const char *proxy_header_to_str(const struct proxy_header *hdr,
                                char *out, size_t out_size)
{
    if (out == NULL || out_size == 0U) {
        return out;
    }
    if (hdr == NULL) {
        snprintf(out, out_size, "(null)");
        return out;
    }

    char src[PROXY_ID_SIZE];
    char dst[PROXY_ID_SIZE];
    proxy_id_to_str(&hdr->src, src, sizeof(src));
    proxy_id_to_str(&hdr->dst, dst, sizeof(dst));

    /* Mirrors the wire layout [version][src_id][dst_id][content] as text.
     * Version is fixed (parse only accepts PROXY_VERSION), so report it. */
    snprintf(out, out_size, "[v%02x][src=%s][dst=%s][content=%u B]",
             (unsigned)PROXY_VERSION, src, dst, (unsigned)hdr->content_len);
    return out;
}
```

## src/proxy_protocol.h
```c
#ifndef PROXY_PROTOCOL_H
#define PROXY_PROTOCOL_H

#include <stdint.h>
#include <stdbool.h>
#include <stddef.h>

/*
 * Proxy application-layer protocol
 *
 * Embedded in Meshtastic Data.payload.bytes with portnum = PROXY_PORTNUM.
 * The nRF52840 reads the DST_ID to route the message to the correct BLE
 * connection.  The Meshtastic mesh is used purely as transport.
 *
 * Wire format:
 *   [VERSION : 1 byte ]
 *   [SRC_ID  : 4 bytes]   sender   identifier (phone number, UUID, etc.)
 *   [DST_ID  : 4 bytes]   receiver identifier
 *   [content : N bytes ]  actual message payload
 *
 * Total header overhead: PROXY_HEADER_SIZE = 9 bytes.
 *
 * Practical Meshtastic payload limit: ~200 bytes (after mesh headers).
 * Available for content: PROXY_CONTENT_MAX = 191 bytes.
 *
 * ID format (4 bytes, null-padded):
 *   - Phone number (e.g. 942756818)
 *   - Any opaque identifier ≤ 4 bytes
 */

/* Meshtastic portnum reserved for this proxy protocol.
 * meshtastic_PortNum_PRIVATE_APP = 256 */
#define PROXY_PORTNUM           256U

/* Practical Meshtastic Data.payload limit (conservative). */
#define PROXY_PRACTICAL_MAX     200U

#define PROXY_VERSION           0x01U
#define PROXY_ID_SIZE           4U
#define PROXY_HEADER_SIZE       (1U + 2U * PROXY_ID_SIZE)                   /* 9 */
#define PROXY_CONTENT_MAX       (PROXY_PRACTICAL_MAX - PROXY_HEADER_SIZE)   /* 191 */

/* Offsets within the raw payload buffer */
#define PROXY_OFF_VERSION       0U
#define PROXY_OFF_SRC           1U
#define PROXY_OFF_DST           (PROXY_OFF_SRC + PROXY_ID_SIZE) /* 5 */
#define PROXY_OFF_CONTENT       PROXY_HEADER_SIZE               /* 9 */

_Static_assert(PROXY_HEADER_SIZE == 1U + 2U * PROXY_ID_SIZE, 
               "PROXY_HEADER_SIZE must follow PROXY_ID_SIZE"); 

/* A 4-byte proxy identifier (phone number, UUID, etc., null-padded). */
typedef struct {
    uint8_t bytes[PROXY_ID_SIZE];
} proxy_id_t;

/* Parsed proxy header. content points into the original buffer. */
struct proxy_header {
    proxy_id_t     src;          /*(sender) message source*/
    proxy_id_t     dst;          /*(receiver) message destination*/
    const uint8_t *content;      /* pointer into original payload buffer */
    uint16_t       content_len;
};

uint32_t proxy_id_value(const uint8_t *bytes); 

/*
 * Parse a proxy header from raw Data.payload bytes.
 *
 * @param payload  Raw bytes from MeshPacket.decoded.payload.bytes
 * @param len      MeshPacket.decoded.payload.size
 * @param out      Populated on success; content points into payload.
 * @return true on success, false if too short or wrong version.
 */
bool proxy_header_parse(const uint8_t *payload, uint16_t len,
                        struct proxy_header *out);

/*
 * Build a proxy-framed payload into dst_buf.
 * Use this in the phone app (or for loopback tests on the nRF).
 *
 * @return Total bytes written, or 0 if content_len > PROXY_CONTENT_MAX
 *         or dst_buf_size is too small.
 */
uint16_t proxy_header_build(const proxy_id_t *src,
                            const proxy_id_t *dst,
                            const uint8_t    *content,
                            uint16_t          content_len,
                            uint8_t          *dst_buf,
                            uint16_t          dst_buf_size);

/* Returns true if the two IDs are byte-for-byte equal. */
bool proxy_id_equal(const proxy_id_t *a, const proxy_id_t *b);

/* Returns true if the ID is all zeros (unregistered). */
bool proxy_id_is_zero(const proxy_id_t *id);

/* Populate a proxy_id_t from a null-terminated string (phone number, etc.).
 * Strings longer than PROXY_ID_SIZE - 1 are truncated. */
void proxy_id_from_str(proxy_id_t *id, const char *str);

/*
 * Render a 4-byte proxy_id as a canonical string — the phone
 * install-id encoding the Android client registers via NODE_REG. `out` must be
 * at least PROXY_ID_STR_SIZE bytes. Always null-terminates. Returns `out`.
 */
const char *proxy_id_to_str(const proxy_id_t *id, char *out, size_t out_size);

/*
 * Render a parsed proxy header as one human-readable line mirroring the wire
 * layout [version][src_id][dst_id][content] — as text, NOT a hexdump:
 *   "[v01][src=<src_value>][dst=<dst_value>][content=<N> B]"
 * `out` must be at least PROXY_HEADER_STR_SIZE bytes. Always null-terminates.
 * Returns `out`.
 */
const char *proxy_header_to_str(const struct proxy_header *hdr,
                                char *out, size_t out_size);

#endif /* PROXY_PROTOCOL_H */
```
